## sdkconfig.defaults
```kconfig
# TLED - Default SDK Configuration for ESP32-C6 Thread

# Target
CONFIG_IDF_TARGET="esp32c6"

# Flash size
CONFIG_ESPTOOLPY_FLASHSIZE_4MB=y

# Partition table
CONFIG_PARTITION_TABLE_CUSTOM=y
CONFIG_PARTITION_TABLE_CUSTOM_FILENAME="partitions.csv"
CONFIG_PARTITION_TABLE_OFFSET=0xC000

# Enable HKDF in mbedtls (required for Matter crypto)
CONFIG_MBEDTLS_HKDF_C=y

# libsodium - use mbedTLS for SHA
CONFIG_LIBSODIUM_USE_MBEDTLS_SHA=y

# Bluetooth (NimBLE) - required for Matter commissioning
CONFIG_BT_ENABLED=y
CONFIG_BT_NIMBLE_ENABLED=y
CONFIG_BT_NIMBLE_EXT_ADV=n
CONFIG_BT_NIMBLE_HCI_EVT_BUF_SIZE=70
CONFIG_USE_BLE_ONLY_FOR_COMMISSIONING=n

# OpenThread - Thread networking
CONFIG_OPENTHREAD_ENABLED=y
CONFIG_OPENTHREAD_SRP_CLIENT=y
CONFIG_OPENTHREAD_DNS_CLIENT=y
CONFIG_OPENTHREAD_LOG_LEVEL_DYNAMIC=n
CONFIG_OPENTHREAD_LOG_LEVEL_NOTE=y
CONFIG_OPENTHREAD_CLI=n

# Disable WiFi (Thread only)
CONFIG_ENABLE_WIFI_STATION=n

# Disable lwip ipv6 autoconfig
CONFIG_LWIP_IPV6_AUTOCONFIG=n

# LwIP config for OpenThread
CONFIG_LWIP_IPV6_NUM_ADDRESSES=8
CONFIG_LWIP_MULTICAST_PING=y
CONFIG_LWIP_HOOK_IP6_ROUTE_DEFAULT=y
CONFIG_LWIP_HOOK_ND6_GET_GW_DEFAULT=y

# Disable WiFi SoftAP (Thread only)
CONFIG_ESP_WIFI_SOFTAP_SUPPORT=n

# MDNS platform
CONFIG_USE_MINIMAL_MDNS=n
CONFIG_ENABLE_EXTENDED_DISCOVERY=y

# OTA Requestor - Matter OTA support
CONFIG_ENABLE_OTA_REQUESTOR=y
CONFIG_OTA_AUTO_REBOOT_ON_APPLY=y
CONFIG_OTA_AUTO_REBOOT_DELAY_MS=5000

# Increase CHIP task stack for OTA operations
CONFIG_CHIP_TASK_STACK_SIZE=16384

# Increase thread/pthread stacks for OTA
CONFIG_THREAD_TASK_STACK_SIZE=8192
CONFIG_PTHREAD_TASK_STACK_SIZE_DEFAULT=4096

# Button timing
CONFIG_BUTTON_PERIOD_TIME_MS=20
CONFIG_BUTTON_LONG_PRESS_TIME_MS=5000

# Enable Matter shell for debugging
CONFIG_ENABLE_CHIP_SHELL=y

# Logging - INFO level to see TLED messages
CONFIG_LOG_DEFAULT_LEVEL_INFO=y
CONFIG_LOG_DEFAULT_LEVEL=3

# Use custom device instance info provider (for TLED branding)
CONFIG_CUSTOM_DEVICE_INSTANCE_INFO_PROVIDER=y

# Watchdog - longer timeout for OTA/Thread operations (120s)
# Both modern and legacy config names to ensure it sticks
CONFIG_ESP_TASK_WDT_PANIC=y
CONFIG_ESP_TASK_WDT_TIMEOUT_S=120
CONFIG_TASK_WDT_PANIC=y
CONFIG_TASK_WDT_TIMEOUT_S=120

# BSP Configuration for DFRobot Beetle ESP32-C6
# Button (Boot button on GPIO9)
CONFIG_BSP_BUTTONS_NUM=1
CONFIG_BSP_BUTTON_1_TYPE_GPIO=y
CONFIG_BSP_BUTTON_1_GPIO=9
CONFIG_BSP_BUTTON_1_LEVEL=0

# LED (Onboard LED on GPIO15 - simple GPIO, not RGB)
CONFIG_BSP_LEDS_NUM=1
CONFIG_BSP_LED_TYPE_GPIO=y
CONFIG_BSP_LED_GPIO=15
```
